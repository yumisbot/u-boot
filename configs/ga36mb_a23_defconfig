## configs/ga36mb_a23_defconfig
```kconfig
CONFIG_ARM=y
CONFIG_ARCH_SUNXI=y
CONFIG_DEFAULT_DEVICE_TREE="sun8i-a23-ga36mb"
CONFIG_DRAM_CLK=552
CONFIG_SPL=y
CONFIG_MACH_SUN8I_A23=y
CONFIG_DRAM_ZQ=63351
CONFIG_AXP_DCDC3_VOLT=1260
CONFIG_AXP_DLDO3_VOLT=3000
# CONFIG_SYS_MALLOC_CLEAR_ON_INIT is not set
CONFIG_CONS_INDEX=3
CONFIG_SYS_MMCSD_RAW_MODE_U_BOOT_SECTOR=0x9530
CONFIG_BOOTDELAY=3
CONFIG_BOOTCOMMAND="mmc dev 0; mmc read 0x42000000 0x2a004 0x2fec; bootz 0x42000000"
```
